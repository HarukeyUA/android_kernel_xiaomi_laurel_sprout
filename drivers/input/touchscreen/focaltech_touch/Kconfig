## drivers/input/touchscreen/focaltech_touch/Kconfig
```kconfig
#
# Focaltech Touchscreen driver configuration
#

config TOUCHSCREEN_FTS_F9S
	bool "Focaltech Touchscreen"
	depends on ( SPI || TOUCHSCREEN_XIAOMI_F9S )
	default n
	help
		Say Y here if you have Focaltech touch panel.
		If unsure, say N.
```
